/dts-v1/;
/plugin/;

/ {
	compatible = "allwinner,sun7i-a20";

	fragment@0 {
		target = <&pio>;
		__overlay__ {
			pps_gen_pins: pps_gen_pins {
				pins = "PI15";
				function = "gpio_out";
			};
		};
	};

	fragment@1 {
		target-path = "/";
		__overlay__ {
			pps-gen {
				compatible = "pps-gen-gpio";
				pinctrl-names = "default";
				pinctrl-0 = <&pps_gen_pins>;
				gpios = <&pio 8 15 0>;  /* PI14 Active Low */
				status = "okay";
				default-state = "off";
			};
		};
	};
};
